## CrowPanel-P4/c6_firmware/main/Kconfig.projbuild
```kconfig
# Include the ESP-Hosted slave Kconfig
rsource "../../factory_project/managed_components/espressif__esp_hosted/slave/main/Kconfig.projbuild"
```

## CrowPanel-P4/c6_firmware/sdkconfig.defaults
```kconfig
# =============================================
# CrowPanel P4 – C6 Coprocessor sdkconfig.defaults
# ESP-Hosted slave + ESP-NOW audio sink
# =============================================

# 1. CPU
CONFIG_ESP_DEFAULT_CPU_FREQ_MHZ_160=y

# 2. SDIO interface (P4 ↔ C6)
CONFIG_ESP_SDIO_HOST_INTERFACE=y

# 3. WiFi
CONFIG_ESP_WIFI_NVS_ENABLED=y

# 4. BT - controller only (for ESP-Hosted BLE passthrough)
CONFIG_BT_ENABLED=y
CONFIG_BT_CONTROLLER_ONLY=y
CONFIG_BT_BLUEDROID_ENABLED=
CONFIG_BT_LE_SLEEP_ENABLE=y
CONFIG_BT_LE_HCI_INTERFACE_USE_RAM=y

# 5. Partition Table
CONFIG_PARTITION_TABLE_CUSTOM=y
CONFIG_PARTITION_TABLE_CUSTOM_FILENAME="partitions.csv"

# 6. Flash
CONFIG_ESPTOOLPY_FLASHSIZE_4MB=y

# 7. OS
CONFIG_FREERTOS_HZ=1000
CONFIG_BOOTLOADER_COMPILER_OPTIMIZATION_PERF=y

# 9. ESP-Hosted peer data transfer (for custom SDIO commands)
CONFIG_ESP_HOSTED_ENABLE_PEER_DATA_TRANSFER=y
CONFIG_ESP_HOSTED_MAX_CUSTOM_MSG_HANDLERS=16
# Mempool MUST stay enabled — disabling it puts a heap_caps_malloc on every
# audio packet (two of them per packet: one in slave_control.c for the
# [msg_id|data] buffer, one in sdio_slave_api.c for the DMA send buffer).
# At 125 packets/s that's 250 mallocs/s + 250 frees/s, and any heap
# fragmentation event becomes an audible audio glitch on the P4.
CONFIG_ESP_HOSTED_USE_MEMPOOL=y
# pserial_task and the SDIO TX path run at this priority. Keeping it at 21
# (the IDF default) means they get preempted by every Wi-Fi MAC task burst
# at prio 23, which is the dominant cause of "late=" drops on the P4. 23
# lets the SDIO write path compete with Wi-Fi instead of being starved by
# it. Don't go above 23 — that risks starving the Wi-Fi driver itself.
CONFIG_ESP_HOSTED_DEFAULT_TASK_PRIORITY=23

# 10. Disable built-in app_main (we provide our own)
# CONFIG_ESP_HOSTED_COPROCESSOR_APP_MAIN is not set

# 11. Disable enterprise WiFi (save flash)
CONFIG_ESP_WIFI_ENTERPRISE_SUPPORT=n

# ECast beacon authentication on C6
CONFIG_MBEDTLS_CMAC_C=y
CONFIG_MBEDTLS_CCM_C=y
```

## CrowPanel-P4/factory_project/components/ota_slave/Kconfig
```kconfig
menu "Slave OTA (C6 coprocessor)"

    config OTA_SLAVE_FORCE_FLASH
        bool "Force unconditional C6 re-flash on next boot"
        default n
        help
            When enabled, the P4 re-flashes the embedded C6 firmware from the
            slave_fw partition on every boot until CONFIG_OTA_SLAVE_FORCE_FLASH
            is cleared and the P4 is reflashed. Skips the C6 application
            version query and the embedded-vs-C6 version comparison. Use this
            to recover a C6 that is stuck in a boot loop / not responding to
            RPC (e.g. after a bad ESP-NOW firmware flash).

            Normal boot flow:
                1. Query C6 app version via custom RPC.
                2. Only OTA if the version differs from the embedded binary.

            Force flow (this option):
                1. Wait for SDIO transport only (no RPC version query).
                2. Always run esp_hosted_slave_ota_{begin,write,end,activate}.
                3. Clear the force flag after activation so the next boot
                   returns to the normal verify path (unless you rebuild with
                   this option still set).

            IMPORTANT: remember to re-embed the updated C6 binary into the
            slave_fw partition (rebuild + reflash the P4) before enabling
            this option, otherwise you will just re-write the same broken
            firmware that is already on the C6.

endmenu
```

## CrowPanel-P4/p4_c6_flasher/sdkconfig.defaults
```kconfig
# ── Target ───────────────────────────────────────────────────────
CONFIG_IDF_TARGET="esp32p4"

# ── Flash ────────────────────────────────────────────────────────
# CrowPanel-P4 has a 16 MB SPI flash.
CONFIG_ESPTOOLPY_FLASHSIZE_16MB=y
CONFIG_ESPTOOLPY_FLASHSIZE="16MB"
CONFIG_ESPTOOLPY_FLASHFREQ_80M=y

# ── Console on USB-Serial-JTAG ──────────────────────────────────
# The CrowPanel-P4's built-in USB-Serial-JTAG is on a *different* USB
# peripheral than the OTG-HS port that TinyUSB drives. Routing the
# console there means you can `idf.py monitor` the bridge over the
# same COM port you flash with, while the new TinyUSB CDC port stays
# fully ours.
# CONFIG_ESP_CONSOLE_UART_DEFAULT is not set
CONFIG_ESP_CONSOLE_USB_SERIAL_JTAG=y
CONFIG_ESP_CONSOLE_SECONDARY_NONE=y

# ── USB device stack (TinyUSB) ───────────────────────────────────
CONFIG_TINYUSB_CDC_ENABLED=y
CONFIG_TINYUSB_CDC_COUNT=1
# Big CDC buffers so esptool's stub upload (~5KB at 115200 baud) and
# any C6 ACK bursts never hit backpressure. 512 was too small and
# caused dropped bytes -> "Serial data stream stopped" in esptool.
CONFIG_TINYUSB_CDC_RX_BUFSIZE=4096
CONFIG_TINYUSB_CDC_TX_BUFSIZE=4096

# Friendly device strings so the OS port shows up as "P4 C6 Flasher".
CONFIG_TINYUSB_DESC_USE_DEFAULT_VID_PID=y
CONFIG_TINYUSB_DESC_MANUFACTURER_STRING="Espressif"
CONFIG_TINYUSB_DESC_PRODUCT_STRING="P4 C6 Flasher"
CONFIG_TINYUSB_DESC_SERIAL_STRING="123456"

# Use the high-speed USB-OTG PHY (ESP32-P4 has both HS-OTG and USB-S/J;
# the CrowPanel USB-C is wired to HS-OTG).
# CONFIG_TINYUSB_RHPORT_HS=y is the default for P4 on esp_tinyusb 1.7.

# ── FreeRTOS / scheduling ────────────────────────────────────────
CONFIG_FREERTOS_HZ=1000
CONFIG_FREERTOS_USE_TICKLESS_IDLE=n

# ── Logging — quiet during streaming ─────────────────────────────
CONFIG_LOG_DEFAULT_LEVEL_INFO=y

# ── App size: tiny single-app layout, no OTA ─────────────────────
CONFIG_PARTITION_TABLE_SINGLE_APP_LARGE=y

# ── Misc ─────────────────────────────────────────────────────────
CONFIG_COMPILER_OPTIMIZATION_PERF=y
```

## ESP32 WROVER Source/main/Kconfig.projbuild
```kconfig
menu "Room audio source"

config ROOM_AUDIO_ROOM_ID
    string "Room ID"
    default "A10-0001"
    help
        Room identifier broadcast by ESP-NOW. Use the XXX-XXXX format
        where each X is alphanumeric (A-Z, a-z, 0-9).

config ROOM_AUDIO_LC3_BITRATE
    int "LC3 per-channel bitrate (bps)"
    default 31200
    range 16000 320000

choice ROOM_AUDIO_PHY_RATE
    prompt "ESP-NOW audio PHY rate"
    default ROOM_AUDIO_PHY_RATE_DSSS5M
    help
        Select the broadcast ESP-NOW PHY rate. DSSS 5.5 Mbps is the
        long-range profile for the reduced 249-byte SBC packets. There
        is no standard ESP-NOW 3 Mbps or 4 Mbps PHY; the next lower rates
        are 2 Mbps and 1 Mbps, which are too airtime-heavy for four-copy
        low-latency audio.

config ROOM_AUDIO_PHY_RATE_MCS1
    bool "MCS1 HT20 long GI"

config ROOM_AUDIO_PHY_RATE_MCS2
    bool "MCS2 HT20 long GI"

config ROOM_AUDIO_PHY_RATE_MCS3
    bool "MCS3 HT20 long GI"

config ROOM_AUDIO_PHY_RATE_OFDM6
    bool "OFDM 6 Mbps"

config ROOM_AUDIO_PHY_RATE_OFDM12
    bool "OFDM 12 Mbps"

config ROOM_AUDIO_PHY_RATE_DSSS5M
    bool "DSSS 5.5 Mbps long preamble"

endchoice

config ROOM_AUDIO_FIXED_CHANNEL
    int "Force ESP-NOW broadcast on a fixed 2.4 GHz channel"
    range 0 13
    default 0
    help
        When set to 0 (default), the source connects to the saved Wi-Fi
        network via STA and inherits its channel for ESP-NOW broadcast.
        When set to 1-13, the source SKIPS the STA join entirely, stays
        in setup-AP-only mode on this channel, and broadcasts ESP-NOW
        on it. Use this to dodge a congested channel that you cannot
        change on the upstream router/hotspot — e.g. set to 11 to move
        off the typically-overloaded channel 1.

        The Web UI is then accessible only via the setup AP
        (SSID "CP-ROOM-SOURCE-SETUP", password "configure123"), since
        the single radio cannot be on two channels simultaneously.

        The sink autoscan covers channels {1, 6, 11}, so for the source
        to be discoverable without sink changes, pick 1, 6, or 11.

endmenu
```

## ESP32 WROVER Source/sdkconfig.defaults
```kconfig
CONFIG_IDF_TARGET="esp32"
CONFIG_ESPTOOLPY_FLASHSIZE_8MB=y
CONFIG_PARTITION_TABLE_CUSTOM=y
CONFIG_PARTITION_TABLE_CUSTOM_FILENAME="partitions.csv"
CONFIG_COMPILER_OPTIMIZATION_PERF=y

# ── Silicon revision ─────────────────────────────────────────────────
# WROVER-IE ships with ESP32-D0WD-V3 (rev v3.x). Setting REV_MIN_3
# disables the DPORT bus-arbitration workaround entirely. That workaround
# (esp_ipc_isr_stall_other_cpu) is the dominant source of brief Core 1
# stalls while Wi-Fi runs on Core 0 — it busy-spins the *other* CPU
# whenever the Wi-Fi/PHY library touches DPORT, which is constant during
# active streaming. Removing it is the single biggest jitter win.
CONFIG_ESP32_REV_MIN_3=y

# ── Wi-Fi buffers / IRAM ─────────────────────────────────────────────
CONFIG_ESP_WIFI_ESPNOW_MAX_ENCRYPT_NUM=0
CONFIG_ESP_WIFI_STATIC_RX_BUFFER_NUM=10
CONFIG_ESP_WIFI_DYNAMIC_RX_BUFFER_NUM=32
CONFIG_ESP_WIFI_DYNAMIC_TX_BUFFER_NUM=32
# For ESP-NOW broadcast we have no real TCP session — AMPDU and a deep
# Block-Ack window just add MAC ISR / DPORT overhead with zero benefit.
# Disabling them measurably reduces MAC-ISR rate.
# CONFIG_ESP_WIFI_AMPDU_TX_ENABLED is not set
# CONFIG_ESP_WIFI_AMPDU_RX_ENABLED is not set
CONFIG_ESP_WIFI_RX_BA_WIN=6
CONFIG_ESP_WIFI_IRAM_OPT=y
CONFIG_ESP_WIFI_RX_IRAM_OPT=y
# We use esp_wifi_set_storage(WIFI_STORAGE_RAM), so the Wi-Fi NVS namespace
# would never be written at runtime; disable the driver hook entirely so
# nothing in the Wi-Fi stack can pull in spi_flash ops behind our back.
# CONFIG_ESP_WIFI_NVS_ENABLED is not set

# ── PHY ──────────────────────────────────────────────────────────────
# Partial RF cal on each Wi-Fi enable (mode 1). Full cal (mode 0) takes
# ~100 ms and triggers an NVS write — that flash op disables flash AND
# PSRAM caches for several ms across both cores. Partial cal is a few
# ms and no NVS write in steady state.
CONFIG_ESP_PHY_CALIBRATION_MODE=1

# ── lwIP ─────────────────────────────────────────────────────────────
CONFIG_LWIP_IRAM_OPTIMIZATION=y
# Pin the TCP/IP thread to Core 0. Default "NO_AFFINITY" lets lwIP
# preempt audio tasks on Core 1 every time the Web UI is touched.
# CONFIG_LWIP_TCPIP_TASK_AFFINITY_NO_AFFINITY is not set
CONFIG_LWIP_TCPIP_TASK_AFFINITY_CPU0=y
CONFIG_LWIP_TCPIP_TASK_AFFINITY=0x0
# CONFIG_LWIP_ESP_GRATUITOUS_ARP is not set
# CONFIG_LWIP_ESP_MLDV6_REPORT is not set

# ── PSRAM ────────────────────────────────────────────────────────────
CONFIG_SPIRAM=y
CONFIG_SPIRAM_USE_MALLOC=y
CONFIG_SPIRAM_MALLOC_ALWAYSINTERNAL=16384

# ── Clocks / scheduler ───────────────────────────────────────────────
CONFIG_ESP_DEFAULT_CPU_FREQ_MHZ_240=y
CONFIG_ESP_DEFAULT_CPU_FREQ_MHZ=240
CONFIG_PM_ENABLE=n
CONFIG_FREERTOS_HZ=1000

# ── Task watchdog ────────────────────────────────────────────────────
# Don't watchdog Core 1 idle — when audio tasks (prio 22-24) are doing
# their job the Core 1 idle task barely runs, which is correct, not a
# bug. Core 0 idle still gets the WDT to catch real hangs.
# CONFIG_ESP_TASK_WDT_CHECK_IDLE_TASK_CPU1 is not set

# CONFIG_COMPILER_OPTIMIZATION_DEBUG is not set
# CONFIG_COMPILER_OPTIMIZATION_SIZE is not set
CONFIG_ROOM_AUDIO_ROOM_ID="A10-0001"
CONFIG_ROOM_AUDIO_LC3_BITRATE=31200
CONFIG_ROOM_AUDIO_PHY_RATE_DSSS5M=y
```

## esp-now-audio-source/main/Kconfig.projbuild
```kconfig
menu "OpenALS Source"

    config SOFTAP_SSID
        string "SoftAP SSID"
        default "ALS_TX"
        help
            SSID of the access point that phones/laptops connect to
            for receiving the UDP audio stream.

    config SOFTAP_PASSWORD
        string "SoftAP Password"
        default "openals123"
        help
            WPA2 password for the access point.  Leave empty for an
            open (no password) network.  Must be at least 8 characters
            when set.

    config SOURCE_AP_IP_C
        int "SoftAP subnet third octet"
        range 1 254
        default 50
        help
            SoftAP uses 192.168.<this>.1/24. Change this if it conflicts
            with your upstream router LAN.

    config AUDIO_QUEUE_LEN
        int "Audio queue length (frames)"
        range 4 64
        default 32
        help
            Number of encoded frames buffered before send task.
            Deeper queue absorbs TX-pipeline stalls (e.g. during MAC
            retry bursts) without dropping captured audio. 32 frames
            = 240 ms of latency headroom, plenty for transient stalls
            yet still bounded by capture-side newest-wins drain.

    config AUDIO_TX_TOKENS
        int "ESP-NOW TX token count"
        range 4 64
        default 64
        help
            Max in-flight ESP-NOW sends before backpressure.
            Each token is held from esp_now_send() until the TX
            callback fires. Under 6 Mbps or interference bursts,
            802.11 MAC retries can hold a token 10-20 ms; at 133
            pps this needs ~2-3 tokens average but spikes to 8-16
            during congestion. 64 gives generous headroom to
            eliminate token-exhaustion drops entirely.

    config AUDIO_TASK_PRIO_CAP_ENC
        int "Capture+encode task priority"
        range 1 23
        default 7

    config AUDIO_TASK_PRIO_SEND
        int "Send task priority"
        range 1 23
        default 8

    choice ESPNOW_RATE
        prompt "ESP-NOW PHY rate"
        default ESPNOW_RATE_24M
        help
            Trade-off between range and pipeline fluidity:
              - 24 Mbps: shortest airtime per frame (~50 us), fastest
                token turnover, minimal tx-queue stalls. Best for short
                to medium range (typical ~15-20 m indoors through 1 wall).
              - 12 Mbps: middle ground.
              - 6 Mbps: ~12 dB more link margin (reaches ~30+ m through
                multiple walls) but each frame takes ~4x more airtime,
                which can exhaust the TX token pool and cause source-side
                audio_q drops at high packet rates.

            For this 133-packet/sec unicast audio workload, 24 Mbps is
            the default because token exhaustion at 6 Mbps causes
            more audible drops than the theoretical range gain is worth.

        config ESPNOW_RATE_6M
            bool "6 Mbps (long range, risks token exhaustion)"

        config ESPNOW_RATE_12M
            bool "12 Mbps"

        config ESPNOW_RATE_24M
            bool "24 Mbps (default, best for smooth audio)"

    endchoice

endmenu
```
